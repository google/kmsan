## lib/Kconfig.initmem
```kconfig
config HAVE_ARCH_INITIALIZE_ALL_MEMORY
	bool

if HAVE_ARCH_INITIALIZE_ALL_MEMORY

menu "Initialize all memory"

config INIT_ALL_MEMORY
	bool "Initialize all memory"
	default n

if INIT_ALL_MEMORY

choice
	prompt "Initialization type"
	depends on INIT_ALL_MEMORY
	default INIT_ALL_MEMORY_ZERO

config INIT_ALL_MEMORY_ZERO
	bool "Initialize all memory with a zero pattern"

config INIT_ALL_MEMORY_PATTERN
	bool "Initialize all memory with a 0xAA pattern"
endchoice


choice
	prompt "Heap initialization"
	depends on INIT_ALL_MEMORY
	default INIT_ALL_HEAP

config INIT_ALL_HEAP
	bool "Initialize all heap (slab and pagealloc)"

config INIT_ALL_HEAP_PAGES
	bool "Initialize only pagealloc pages"

config NOINIT_ALL_HEAP
	bool "Don't initialize any heap pages"
endchoice

config INIT_ALL_STACK
	bool "Initialize all stack"
	depends on INIT_ALL_MEMORY
	default y


endif # INIT_ALL_MEMORY
endmenu

endif # HAVE_ARCH_INITIALIZE_ALL_MEMORY
```

## lib/Kconfig.kmsan
```kconfig
# SPDX-License-Identifier: GPL-2.0-only
config HAVE_ARCH_KMSAN
	bool

config HAVE_KMSAN_COMPILER
	# Clang versions <14.0.0 also support -fsanitize=kernel-memory, but not
	# all the features necessary to build the kernel with KMSAN.
	depends on CC_IS_CLANG && CLANG_VERSION >= 140000
	def_bool $(cc-option,-fsanitize=kernel-memory -mllvm -msan-disable-checks=1 -fsanitize-memory-param-retval)

config KMSAN
	bool "KMSAN: detector of uninitialized values use"
	depends on HAVE_ARCH_KMSAN && HAVE_KMSAN_COMPILER
	depends on SLUB && DEBUG_KERNEL && !KASAN && !KCSAN
	select STACKDEPOT
	select STACKDEPOT_ALWAYS_INIT
	help
	  KernelMemorySanitizer (KMSAN) is a dynamic detector of uses of
	  uninitialized values in the kernel. It is based on compiler
	  instrumentation provided by Clang and thus requires Clang to build.

	  An important note is that KMSAN is not intended for production use,
	  because it drastically increases kernel memory footprint and slows
	  the whole system down.

	  See <file:Documentation/dev-tools/kmsan.rst> for more details.

if KMSAN

config KMSAN_KUNIT_TEST
	tristate "KMSAN integration test suite" if !KUNIT_ALL_TESTS
	default KUNIT_ALL_TESTS
	depends on TRACEPOINTS && KUNIT
	help
	  Test suite for KMSAN, testing various error detection scenarios,
	  and checking that reports are correctly output to console.

	  Say Y here if you want the test to be built into the kernel and run
	  during boot; say M if you want the test to build as a module; say N
	  if you are unsure.

endif
```
